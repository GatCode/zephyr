## CMakeLists.txt
```
# SPDX-License-Identifier: Apache-2.0

cmake_minimum_required(VERSION 3.20.0)
find_package(Zephyr REQUIRED HINTS $ENV{ZEPHYR_BASE})
project(periodic_sync)

target_sources(app PRIVATE
    src/main.c
    src/throughput_explorer.c
)

zephyr_library_include_directories(include)
```

## prj.conf
```kconfig
CONFIG_BT=y
CONFIG_BT_BROADCASTER=y
CONFIG_BT_OBSERVER=y
CONFIG_BT_EXT_ADV=y
CONFIG_BT_DEBUG_LOG=y
CONFIG_BT_DEVICE_NAME="Extended Receiver"
CONFIG_BT_CTLR_ADV_EXT=y
CONFIG_CBPRINTF_FP_SUPPORT=y

# Enable DK LED and Buttons library
CONFIG_GPIO=y

CONFIG_COUNTER=y
CONFIG_COUNTER_TIMER2=y

CONFIG_NRF_RTC_TIMER=y
CONFIG_NRF53_SYNC_RTC=y

CONFIG_BT_BUF_EVT_RX_COUNT=64
CONFIG_BT_BUF_EVT_RX_SIZE=255

CONFIG_BT_CTLR_PHY_CODED=y
CONFIG_BT_CTLR_RX_BUFFERS=18

CONFIG_BT_CTLR_SCAN_DATA_LEN_MAX=191

CONFIG_BT_CTLR_ADV_DATA_LEN_MAX=191
CONFIG_BT_CTLR_ADV_DATA_BUF_MAX=1
```

## src/main.c
```c
#include <device.h>
#include <bluetooth/bluetooth.h>
#include <drivers/gpio.h>
#include <bluetooth/hci.h>

#include <throughput_explorer.h>

#define SW0_NODE DT_ALIAS(sw0)
static const struct gpio_dt_spec button0 = GPIO_DT_SPEC_GET_OR(SW0_NODE, gpios, {0});
static struct gpio_callback button0_cb_data;

#define SW1_NODE DT_ALIAS(sw1)
static const struct gpio_dt_spec button1 = GPIO_DT_SPEC_GET_OR(SW1_NODE, gpios, {0});
static struct gpio_callback button1_cb_data;

static struct sync_payload sync = {0};

static int64_t time_offset = 0;

static K_SEM_DEFINE(sem_sync, 0, 1);

static const struct bt_data ad[] = {
	BT_DATA(BT_DATA_MANUFACTURER_DATA, &sync, sizeof(struct sync_payload)),
};

static struct bt_le_ext_adv_start_param ext_adv_start_param = {
	.num_events = 1,
};

void sync_button_pressed(const struct device *dev, struct gpio_callback *cb, uint32_t pins)
{
	k_sem_give(&sem_sync);
}

void debug_button_pressed(const struct device *dev, struct gpio_callback *cb, uint32_t pins)
{
	printk("%.2f ms\n", k_ticks_to_us_floor64(z_nrf_rtc_timer_read() + time_offset) / 1000.0);
}

static bool data_cb(struct bt_data *data, void *user_data)
{
	switch (data->type) {
	case BT_DATA_MANUFACTURER_DATA:
		memcpy(user_data, data->data, sizeof(struct sync_payload));
		return false;
	default:
		return true;
	}
}

void scan_cb(const bt_addr_le_t *addr, int8_t rssi, uint8_t adv_type,
		    struct net_buf_simple *buf)
{
	if(adv_type == BT_GAP_ADV_TYPE_EXT_ADV) {

		bt_data_parse(buf, data_cb, &sync);
		u64_to_u8_arr(z_nrf_rtc_timer_read(), sync.t4);

		printk("-------------\n");
		uint64_t t1, t2, t3, t4;
		u8_arr_to_u64(sync.t1, &t1);
		u8_arr_to_u64(sync.t2, &t2);
		u8_arr_to_u64(sync.t3, &t3);
		u8_arr_to_u64(sync.t4, &t4);
		printk("T1: %llu\n", t1);
		printk("T2: %llu\n", t2);
		printk("T3: %llu\n", t3);
		printk("T4: %llu\n", t4);

		// calculations according to RFC4330
		// "NTP provides accuracies of 1-50 ms"
		int64_t d = (t4 - t1) - (t3 - t2);
		double t = ((t2 - t1) + (t3 - t4)) / 2;

		printk("d = %llu\n", d);
		printk("t = %.2f\n", t);

		time_offset = t - d/2;

		printk("-------------\n");
	}
}

void main(void)
{
	int err;
	struct bt_le_ext_adv *adv;

	/* Initialize Sync Button */
	if (!device_is_ready(button0.port)) {
		printk("Error: button device is not ready\n");
		return;
	}

	err = gpio_pin_configure_dt(&button0, GPIO_INPUT);
	if (err != 0) {
		printk("Error %d: failed to configure %s pin %d\n", err, button0.port->name, button0.pin);
		return;
	}

	err = gpio_pin_interrupt_configure_dt(&button0, GPIO_INT_EDGE_TO_ACTIVE);
	if (err != 0) {
		printk("Error %d: failed to configure interrupt on %s pin %d\n", err, button0.port->name, button0.pin);
		return;
	}

	gpio_init_callback(&button0_cb_data, sync_button_pressed, BIT(button0.pin));
	gpio_add_callback(button0.port, &button0_cb_data);

	/* Initialize Debug Button */
	if (!device_is_ready(button1.port)) {
		printk("Error: button device is not ready\n");
		return;
	}

	err = gpio_pin_configure_dt(&button1, GPIO_INPUT);
	if (err != 0) {
		printk("Error %d: failed to configure %s pin %d\n", err, button1.port->name, button1.pin);
		return;
	}

	err = gpio_pin_interrupt_configure_dt(&button1, GPIO_INT_EDGE_TO_ACTIVE);
	if (err != 0) {
		printk("Error %d: failed to configure interrupt on %s pin %d\n", err, button1.port->name, button1.pin);
		return;
	}

	gpio_init_callback(&button1_cb_data, debug_button_pressed, BIT(button1.pin));
	gpio_add_callback(button1.port, &button1_cb_data);
	
	/* Enable and setup Bluetooth */
	err = bt_enable(NULL);
	if (err) {
		printk("Bluetooth init failed (err %d)\n", err);
		return;
	}

	/* Enable Scanning */
	struct bt_le_scan_param scan_param = {
        .type = BT_LE_SCAN_TYPE_PASSIVE,
        .options = BT_LE_SCAN_OPT_CODED | BT_LE_SCAN_OPT_NO_1M | BT_LE_SCAN_OPT_FILTER_DUPLICATE,
        .interval = 0x0a80  /* 80 ms */,
        .window = 0x0a80 /* 80ms */,
		.timeout = 0,
		.interval_coded = 0,
        .window_coded = 0,
    };

	err = bt_le_scan_start(&scan_param, &scan_cb);
	if (err) {
		printk("Bluetooth scan start failed (err %d)\n", err);
		return;
	}

	/* Enable Extended Advertising */
	struct bt_le_adv_param adv_param = {
		.options =  BT_LE_ADV_OPT_EXT_ADV | BT_LE_ADV_OPT_CODED,
		.interval_min = 0x0020 /* 20ms */,
		.interval_max = 0x0020 /* 20ms */,
		.secondary_max_skip = 0,
	};

	err = bt_le_ext_adv_create(&adv_param, NULL, &adv);
	if (err) {
		printk("Failed to create extended advertisement (err %d)\n", err);
		return;
	}

	/* Sync Loop */
	while(1) {
		err = k_sem_take(&sem_sync, K_FOREVER);
		if (err) {
			printk("failed (err %d)\n", err);
			return;
		}

		u64_to_u8_arr(z_nrf_rtc_timer_read(), sync.t1);
	
		int err = bt_le_ext_adv_set_data(adv, ad, ARRAY_SIZE(ad), NULL, 0);
		if (err) {
			printk("Failed to set advertising data!\n");
			return;
		}

		err = bt_le_ext_adv_start(adv, &ext_adv_start_param);
		if (err) {
			printk("Failed to start extended advertising!\n");
			return;
		}
	}
}
```

## include/throughput_explorer.h
```c
#ifndef THROUGHPUTEXPLORER_H
#define THROUGHPUTEXPLORER_H

#include <zephyr.h>

struct explorer_config {
	/**
	 * @brief ID of the current packet.
	 *
	 * The packet id is needed to be able to detect the absence
	 * of packets on the receiver side.
	 */
	uint64_t packet_id;
	/**
	 * @brief Time offset between boot and reset_config call.
	 *
	 * Time offset between the MCU boot and the previous call to
	 * reset_config. This timestamp is needed for sender/receiver
	 * synchronization. Allows the RTC to act as a counter starting
	 * at an artificial zero point (rtc_offset).
	 */
	uint64_t rtc_offset;
};

struct sync_payload {
	/**
	 * @brief u8[8] containing the timestamp.
	 */
	uint8_t t1[8];
	/**
	 * @brief u8[8] containing the timestamp.
	 */
	uint8_t t2[8];
	/**
	 * @brief u8[8] containing the timestamp.
	 */
	uint8_t t3[8];
	/**
	 * @brief u8[8] containing the timestamp.
	 */
	uint8_t t4[8];
};

struct explorer_payload {
	/**
	 * @brief u8[8] containing the packet ID.
	 */
	uint8_t id[8];
	/**
	 * @brief u8[8] containing the timestamp.
	 */
	uint8_t timestamp[8];

	// uint8_t dummy_data[211];
};

struct explorer_statistic {
	/**
	 * @brief Total number of received packets.
	 */
	uint64_t recv;
	/**
	 * @brief Total number of lost packets.
	 */
	uint64_t lost;
	/**
	 * @brief Number of lost packets before the current one.
	 */
	uint64_t currently_lost;
	/**
	 * @brief ID of the received packet.
	 */
	uint64_t id;
	/**
	 * @brief Timestamp of the received packet.
	 */
	uint64_t timestamp;
	/**
	 * @brief ID of the last received packet.
	 */
	int64_t last_packet_id;
	/**
	 * @brief Latency of the current packet.
	 */
	uint64_t latency;

	uint64_t recv_since_timer_reset;
	uint64_t current_throughput;
};

/** Convert u64 to u8[8] for Bluetooth transmission. */
int u64_to_u8_arr(uint64_t input, uint8_t *output);

/** Convert u8[8] to u64 after Bluetooth transmission. */
int u8_arr_to_u64(uint8_t *input, uint64_t *output);

/** Throughput Explorer Payload Setter - ID. */
int set_id(uint64_t id, struct explorer_payload *payload);

/**
 * @brief Throughput Explorer Payload Getter - ID.
 *
 * This function extracts the id from the payload, converts
 * it to uint64_t and stores this value in the explorer_statistic
 *
 * @param statistic   Throughput Explorer Statistic.
 * @param payload     Throughput Explorer Payload.
 *
 * @return Zero on success or (negative) error code otherwise.
 */
int get_id(struct explorer_statistic *statistic, struct explorer_payload *payload);

/** Throughput Explorer Payload Setter - Timestamp. */
int set_timestamp(uint64_t current_ts, struct explorer_config *cfg, struct explorer_payload *payload);

/**
 * @brief Throughput Explorer Payload Getter - Timestamp.
 *
 * This function extracts the timestamp from the payload, converts
 * it to uint64_t and stores this value in the explorer_statistic
 *
 * @param statistic   Throughput Explorer Statistic.
 * @param payload     Throughput Explorer Payload.
 *
 * @return Zero on success or (negative) error code otherwise.
 */
int get_timestamp(struct explorer_statistic *statistic, struct explorer_payload *payload);

/**
 * @brief Reset Throughput Explorer Config.
 *
 * This function sets all member variables of the throughput explorer
 * to zero and sets the rtc_offset to the current RTC timestamp.
 *
 * @param cfg   Throughput Explorer Config.
 *
 * @return Zero on success or (negative) error code otherwise.
 */
int reset_config(struct explorer_config *cfg);

/** Reset Throughput Explorer Statistic. */
int reset_statistic(struct explorer_statistic *statistic);

/**
 * @brief Update Throughput Explorer Payload.
 *
 * This function updates the payload by increasing the packet_id
 * and setting the current RTC timestamp.
 *
 * @param cfg       Throughput Explorer Config.
 * @param payload   Throughput Explorer Payload.
 *
 * @return Zero on success or (negative) error code otherwise.
 */
int update_payload(struct explorer_config *cfg, struct explorer_payload *payload);

/**
 * @brief Update Throughput Explorer Statistic.
 *
 * This function updates the statistic with the payload contents,
 * calculates the latency and determines the link quality
 *
 * @param statistic   Throughput Explorer Statistic.
 * @param cfg         Throughput Explorer Config.
 * @param payload     Throughput Explorer Payload.
 *
 * @return Zero on success or (negative) error code otherwise.
 */
int update_statistic(struct explorer_statistic *statistic, struct explorer_config *cfg, struct explorer_payload *payload);

/**
 * @brief Prints the content of the explorer_statistic.
 *
 * This function visualizes the explorer_statistic.
 *
 * @param statistic   Throughput Explorer Statistic.
 *
 * @return Zero on success or (negative) error code otherwise.
 */
int print_statistic(struct explorer_statistic *statistic, uint8_t skip_packets);

#endif
```

## src/throughput_explorer.c
```c
#include <throughput_explorer.h>
#include <drivers/timer/nrf_rtc_timer.h>

int u64_to_u8_arr(uint64_t input, uint8_t *output)
{
    if(output == NULL) {
        return -EINVAL;
    }

    for (int i = 0; i < 8; i++) {
        output[i] = input >> (8 * i);
    }

    return 0;
}

int u8_arr_to_u64(uint8_t *input, uint64_t *output)
{
    if(input == NULL || output == NULL) {
        return -EINVAL;
    }

    *output =
    (uint64_t)input[0] << 0 * 8 |
    (uint64_t)input[1] << 1 * 8 |
    (uint64_t)input[2] << 2 * 8 |
    (uint64_t)input[3] << 3 * 8 |
    (uint64_t)input[4] << 4 * 8 |
    (uint64_t)input[5] << 5 * 8 |
    (uint64_t)input[6] << 6 * 8 |
    (uint64_t)input[7] << 7 * 8;

    return 0;
}

int set_id(uint64_t id, struct explorer_payload *payload)
{
    if(payload == NULL) {
        return -EINVAL;
    }

    u64_to_u8_arr(id, payload->id);
    
    return 0;
}

int get_id(struct explorer_statistic *statistic, struct explorer_payload *payload)
{
    if(statistic == NULL || payload == NULL) {
        return -EINVAL;
    }

    u8_arr_to_u64(payload->id, &statistic->id);

    return 0;
}


int set_timestamp(uint64_t current_ts, struct explorer_config *cfg, struct explorer_payload *payload)
{
    if(cfg == NULL || payload == NULL) {
        return -EINVAL;
    }
        
    u64_to_u8_arr(current_ts - cfg->rtc_offset, payload->timestamp);

    return 0;
}

int get_timestamp(struct explorer_statistic *statistic, struct explorer_payload *payload)
{
    if(statistic == NULL || payload == NULL) {
        return -EINVAL;
    }

    u8_arr_to_u64(payload->timestamp, &statistic->timestamp);

    return 0;
}

int reset_config(struct explorer_config *cfg)
{
    if(cfg == NULL) {
        return -EINVAL;
    }
    
    cfg->packet_id = 0;
    cfg->rtc_offset = z_nrf_rtc_timer_read();

    return 0;
}

int reset_statistic(struct explorer_statistic *statistic)
{
    if(statistic == NULL) {
        return -EINVAL;
    }
    
    statistic->recv = 0;
    statistic->lost = 0;
    statistic->currently_lost = 0;
    statistic->id = 0;
    statistic->timestamp = 0;
    statistic->last_packet_id = -1;
    statistic->latency = 0;

    return 0;
}

int update_payload(struct explorer_config *cfg, struct explorer_payload *payload)
{
    if(cfg == NULL || payload == NULL) {
        return -EINVAL;
    }
    
    set_id(cfg->packet_id++, payload);
	set_timestamp(z_nrf_rtc_timer_read(), cfg, payload);

    return 0;
}

int update_statistic(struct explorer_statistic *statistic, struct explorer_config *cfg, struct explorer_payload *payload)
{
    if(statistic == NULL || cfg == NULL || payload == NULL) {
        return -EINVAL;
    }

    get_id(statistic, payload);
    get_timestamp(statistic, payload);
    statistic->latency = z_nrf_rtc_timer_read() - cfg->rtc_offset - statistic->timestamp;

    if(statistic->id != statistic->last_packet_id + 1) {
        statistic->currently_lost = statistic->id - statistic->last_packet_id;
        statistic->lost += statistic->currently_lost;
    } else {
        statistic->recv++;
    }

    statistic->last_packet_id = statistic->id;

    return 0;
}

int print_statistic(struct explorer_statistic *statistic, uint8_t skip_packets)
{
    if(statistic == NULL) {
        return -EINVAL;
    }

	if((statistic->recv + statistic->lost) % skip_packets == 0) {
		printk("Received: %llu/%llu (%.2f%%) - Latency %.2f ms\n",
			statistic->recv, statistic->recv + statistic->lost,
			(float)statistic->recv * 100 / (statistic->recv + statistic->lost),
            k_ticks_to_us_floor64(statistic->latency) / 1000.0);
	}

    return 0;
}
```
