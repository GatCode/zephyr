## prj.conf
```kconfig
CONFIG_BT=y
CONFIG_BT_EXT_ADV=y
CONFIG_BT_PER_ADV=y
CONFIG_BT_DEBUG_LOG=y
CONFIG_BT_DEVICE_NAME="Test Periodic Advertising"
# CONFIG_BT_CTLR_TX_PWR_MINUS_40=y
CONFIG_BT_CTLR_DEBUG_PINS=y
```

## src/main.c
```c
/*
 * Copyright (c) 2020 Nordic Semiconductor ASA
 *
 * SPDX-License-Identifier: Apache-2.0
 */

#include <zephyr/bluetooth/bluetooth.h>

static uint8_t mfg_data[] = { 0xad, 0xde, 0xbe, 0xef };

static const struct bt_data ad[] = {
	BT_DATA(BT_DATA_MANUFACTURER_DATA, mfg_data, 3),
};

void main(void)
{
	struct bt_le_ext_adv *adv;
	int err;

	printk("Starting Periodic Advertising Demo\n");

	/* Initialize the Bluetooth Subsystem */
	err = bt_enable(NULL);
	if (err) {
		printk("Bluetooth init failed (err %d)\n", err);
		return;
	}

	/* Create a non-connectable non-scannable advertising set */
	#define BT_LE_EXT_ADV_NCONN_NAME_CUSTOM BT_LE_ADV_PARAM(BT_LE_ADV_OPT_EXT_ADV | \
						 BT_LE_ADV_OPT_USE_NAME, \
						 BT_GAP_ADV_FAST_INT_MIN_2, \
						 BT_GAP_ADV_FAST_INT_MIN_2, \
						 NULL)

	err = bt_le_ext_adv_create(BT_LE_EXT_ADV_NCONN_NAME_CUSTOM, NULL, &adv);
	if (err) {
		printk("Failed to create advertising set (err %d)\n", err);
		return;
	}

	/* Set periodic advertising parameters */
	err = bt_le_per_adv_set_param(adv, BT_LE_PER_ADV_DEFAULT);
	if (err) {
		printk("Failed to set periodic advertising parameters"
		       " (err %d)\n", err);
		return;
	}

	/* Enable Periodic Advertising */
	err = bt_le_per_adv_start(adv);
	if (err) {
		printk("Failed to enable periodic advertising (err %d)\n", err);
		return;
	}

	printk("Start Extended Advertising...");
	err = bt_le_ext_adv_start(adv, BT_LE_EXT_ADV_START_DEFAULT);
	if (err) {
		printk("Failed to start extended advertising "
				"(err %d)\n", err);
		return;
	}
	printk("done.\n");

	printk("Set Periodic Advertising Data...");
	err = bt_le_per_adv_set_data(adv, ad, ARRAY_SIZE(ad));
	if (err) {
		printk("Failed (err %d)\n", err);
		return;
	}
	printk("done.\n");

	while (true) {
		// printk("Start Extended Advertising...");
		// err = bt_le_ext_adv_start(adv, BT_LE_EXT_ADV_START_DEFAULT);
		// if (err) {
		// 	printk("Failed to start extended advertising "
		// 	       "(err %d)\n", err);
		// 	return;
		// }
		// printk("done.\n");

		// for (int i = 0; i < 3; i++) {
		// 	k_sleep(K_SECONDS(10));

		// 	mfg_data[2]++;

		// 	printk("Set Periodic Advertising Data...");
		// 	err = bt_le_per_adv_set_data(adv, ad, ARRAY_SIZE(ad));
		// 	if (err) {
		// 		printk("Failed (err %d)\n", err);
		// 		return;
		// 	}
		// 	printk("done.\n");
		// }

		// k_sleep(K_SECONDS(10));

		// printk("Stop Extended Advertising...");
		// err = bt_le_ext_adv_stop(adv);
		// if (err) {
		// 	printk("Failed to stop extended advertising "
		// 	       "(err %d)\n", err);
		// 	return;
		// }
		// printk("done.\n");

		k_sleep(K_SECONDS(10));
	}
}
```
