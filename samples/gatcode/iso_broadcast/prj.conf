## CMakeLists.txt
```
# SPDX-License-Identifier: Apache-2.0

cmake_minimum_required(VERSION 3.20.0)
find_package(Zephyr REQUIRED HINTS $ENV{ZEPHYR_BASE})
project(iso_broadcast)

target_sources(app PRIVATE
    src/main.c
    src/ble_hci_vsc.c
)

zephyr_library_include_directories(include)
```

## prj.conf
```kconfig
# General
CONFIG_REBOOT=y
CONFIG_MAIN_STACK_SIZE=1940

# Bluetooth
CONFIG_BT_PRIVACY=n
CONFIG_BT_GATT_CLIENT=y
CONFIG_BT_GATT_DYNAMIC_DB=y

# As long as thread names are used, config must be set to "y"
CONFIG_THREAD_NAME=y

# Bluetooth General
CONFIG_BT=y
CONFIG_BT_DEVICE_NAME="ISO Broadcaster"

# Enable Host Only Mode
CONFIG_BT_HCI=y
CONFIG_BT_CTLR=n

# Disable Zephyr HCI Vendor-Specific extensions
CONFIG_BT_HCI_VS_EXT=n

# Make sure we have enough space
CONFIG_BT_ISO_RX_MTU=251
CONFIG_BT_ISO_TX_MTU=251
CONFIG_BT_L2CAP_TX_BUF_COUNT=6
CONFIG_BT_RX_STACK_SIZE=2000
CONFIG_BT_BUF_ACL_RX_SIZE=259

# Not supported on Packetcraft controller
CONFIG_BT_ATT_ENFORCE_FLOW=n

# Only do pairing without bonding
CONFIG_BT_BONDABLE=n
CONFIG_BT_EXT_ADV=y
CONFIG_BT_PER_ADV=y
CONFIG_BT_ISO_BROADCASTER=y

# Temporary, enable the following to meet BT_ISO dependencies
CONFIG_BT_OBSERVER=y
CONFIG_BT_PERIPHERAL=y

# Allow for ACL Connection
CONFIG_BT_CENTRAL=y
CONFIG_BT_BROADCASTER=y

# Avoid multi-build system build network core firmware
CONFIG_NCS_INCLUDE_RPMSG_CHILD_IMAGE=n

# Temporarily disabled connetion parameter and PHY update
CONFIG_BT_GAP_AUTO_UPDATE_CONN_PARAMS=n
CONFIG_BT_AUTO_PHY_UPDATE=n
CONFIG_BT_AUTO_DATA_LEN_UPDATE=n

# Logging
CONFIG_CBPRINTF_FP_SUPPORT=y
CONFIG_BT_DEBUG_LOG=y

# Activate lines below to disable all serial output
# CONFIG_PRINTK=n
# CONFIG_CONSOLE=n
# CONFIG_SERIAL=n
# CONFIG_STDOUT_CONSOLE=n
# CONFIG_UART_CONSOLE=n
```

## boards/thingy53_nrf5340_cpuapp.conf
```kconfig
# Needed for Thingy:53 serial output
CONFIG_USB_DEVICE_STACK=y
CONFIG_USB_DEVICE_REMOTE_WAKEUP=n
CONFIG_USB_DEVICE_PRODUCT="Thingy:53 Application"
CONFIG_USB_DEVICE_VID=0x1915
CONFIG_USB_DEVICE_PID=0x530C
CONFIG_USB_CDC_ACM=y
```

## boards/thingy53_nrf5340_cpuapp.overlay
```dts
/ {
	chosen {
		zephyr,console = &cdc_acm_uart0;
	};
};

&zephyr_udc0 {
	cdc_acm_uart0: cdc_acm_uart0 {
		compatible = "zephyr,cdc-acm-uart";
		label = "CDC_ACM_0";
	};
};

// // If mode == 0 -> Chip production default value used (+20 dBm)
// / {
// 	nrf_radio_fem: name_of_fem_node {
// 	   compatible  = "nordic,nrf21540-fem";
// 	   mode-gpios  = <&gpio1 12 GPIO_ACTIVE_LOW>;
// 	   tx-en-gpios = <&gpio0 30 GPIO_ACTIVE_HIGH>;
// 	   rx-en-gpios = <&gpio0 11 GPIO_ACTIVE_HIGH>;
// 	   pdn-gpios   = <&gpio0 10 GPIO_ACTIVE_HIGH>;
//  };
// };
```

## include/ble_hci_vsc.h
```c
/*
 * NOTE: parts of the code below and the corresponding source file
 * are copied from the Nordic nrf5340_audio sample (sdk-nrf on GitHub)
 */

#ifndef _BLE_HCI_VSC_H_
#define _BLE_HCI_VSC_H_

#include <zephyr/kernel.h>

#define HCI_OPCODE_VS_SET_ADV_TX_PWR BT_OP(BT_OGF_VS, 0x3F5)
#define HCI_OPCODE_VS_SET_RADIO_FE_CFG BT_OP(BT_OGF_VS, 0x3A3)
#define HCI_OPCODE_VS_SET_PRI_EXT_ADV_MAX_TX_PWR BT_OP(BT_OGF_VS, 0x000)
#define HCI_OPCODE_VS_SET_CONN_TX_PWR BT_OP(BT_OGF_VS, 0x3F6)

struct ble_hci_vs_rp_status {
	int8_t status;
} __packed;

struct ble_hci_vs_cp_set_adv_tx_pwr {
	int8_t tx_power;
} __packed;

struct ble_hci_vs_cp_set_conn_tx_pwr {
	uint16_t handle;
	int8_t tx_power;
} __packed;

struct ble_hci_vs_cp_set_radio_fe_cfg {
	int8_t max_tx_power;
	uint8_t ant_id;
} __packed;

struct ble_hci_vs_tx_pwr_setting {
	int8_t tx_power;
	bool add_3dBm;
} __packed;

enum ble_hci_vs_tx_power {
	BLE_HCI_VSC_TX_PWR_0dBm = 0,
	BLE_HCI_VSC_TX_PWR_Neg1dBm = -1,
	BLE_HCI_VSC_TX_PWR_Neg2dBm = -2,
	BLE_HCI_VSC_TX_PWR_Neg3dBm = -3,
	BLE_HCI_VSC_TX_PWR_Neg4dBm = -4,
	BLE_HCI_VSC_TX_PWR_Neg5dBm = -5,
	BLE_HCI_VSC_TX_PWR_Neg6dBm = -6,
	BLE_HCI_VSC_TX_PWR_Neg7dBm = -7,
	BLE_HCI_VSC_TX_PWR_Neg8dBm = -8,
	BLE_HCI_VSC_TX_PWR_Neg12dBm = -12,
	BLE_HCI_VSC_TX_PWR_Neg16dBm = -16,
	BLE_HCI_VSC_TX_PWR_Neg20dBm = -20,
	BLE_HCI_VSC_TX_PWR_Neg40dBm = -40,
	BLE_HCI_VSC_TX_PWR_INVALID = 99,
	BLE_HCI_VSC_PRI_EXT_ADV_MAX_TX_PWR_DISABLE = 127,
};

enum ble_hci_vs_led_function_id {
	PAL_LED_ID_CPU_ACTIVE = 0x10,
	PAL_LED_ID_ERROR = 0x11,
	PAL_LED_ID_BLE_TX = 0x12,
	PAL_LED_ID_BLE_RX = 0x13,
};

enum ble_hci_vs_led_function_mode {
	PAL_LED_MODE_ACTIVE_LOW = 0x00,
	PAL_LED_MODE_ACTIVE_HIGH = 0x01,
	PAL_LED_MODE_DISABLE_TOGGLE = 0xFF,
};

/**
 * @brief Returns the appropriate txp vsc index
 * 
 * @return txp index
 */
uint8_t get_hci_vsc_tx_pwr_idx(int8_t txp);

/**
 * @brief Returns the appropriate txp value
 * 
 * @return txp value
 */
uint8_t get_txp_value_by_index(uint8_t txp_idx);

/**
 * @brief Initializes the available_vs_tx_pwr_settings options.
 */
void init_ble_hci_vsc_tx_pwr();

/**
 * @brief Enable VREGRADIO.VREQH in NET core for getting +3dBm TX power
 *        Note, this will add +3 dBm for the primary advertisement channels
 *        as well even ble_hci_vsc_set_pri_ext_adv_max_tx_pwr() has been used
 * @param high_power_mode	Enable VREGRADIO.VREQH or not
 *
 * @return 0 for success, error otherwise.
 */
int ble_hci_vsc_set_radio_high_pwr_mode(bool high_power_mode);

/**
 * @brief Set advertising TX power
 * @param tx_power TX power setting for the advertising.
 *                 Please check ble_hci_vs_tx_power for possible settings
 *
 * @return 0 for success, error otherwise.
 */
int ble_hci_vsc_set_adv_tx_pwr(enum ble_hci_vs_tx_power tx_power);

/**
 * @brief Set the maximum transmit power on primary advertising channels
 * @param tx_power TX power setting for the primary advertising channels
 *                 in advertising extension, which are BLE channel 37, 38 and 39
 *                 Please check ble_hci_vs_tx_power for possible settings
 *                 Set to BLE_HCI_VSC_PRI_EXT_ADV_MAX_TX_PWR_DISABLE (-127) for
 *                 disabling this feature
 *
 * @return 0 for success, error otherwise.
 */
int ble_hci_vsc_set_pri_ext_adv_max_tx_pwr(enum ble_hci_vs_tx_power tx_power);

/**
 * @brief Set the maximum transmit power
 * @param pwr_setting_index 	TX power setting index - see available_vs_tx_pwr_settings.
 *
 * @return 0 for success, error otherwise.
 */
int ble_hci_vsc_set_tx_pwr(uint8_t pwr_setting_index);

/**
 * @brief Set TX power for specific connection
 * @param conn_handle Specific connection handle for TX power setting
 * @param tx_power TX power setting for the specific connection handle
 *                 Please check ble_hci_vs_tx_power for possible settings
 *
 * @return 0 for success, error otherwise.
 */
int ble_hci_vsc_set_conn_tx_pwr(uint16_t conn_handle, enum ble_hci_vs_tx_power tx_power);

/**
 * @brief Set TX power for specific connection
 * @param conn_handle Specific connection handle for TX power setting
 * @param pwr_setting_index TX power setting index - see available_vs_tx_pwr_settings.
 *
 * @return 0 for success, error otherwise.
 */
int ble_hci_vsc_set_conn_tx_pwr_index(uint16_t conn_handle, uint8_t pwr_setting_index);

#endif /* _BLE_HCI_VSC_H_ */
```

## include/lut.h
```c
struct isochronous_parameter_lut {
    int8_t txp;
    uint8_t rtn;
    double delta_prr;
    double delta_cost;
};

static const struct isochronous_parameter_lut iso_lut[5] = {
    {-16, 0, 0.0, 0.0},
    {-8, 0, 34.24032258064516, 1.9064436976689692},
    {-4, 0, 83.17599825632084, 3.427435394649092},
    {0, 0, 125.53155381187639, 7.5755945682312475},
    {2, 0, 160.09684792952345, 17.738584543507606},
    // {4, 0, 185.723276500952, 23.269463441617198},
    // {4, 2, 200.62964013731565, 40.069508094625036},
    // {8, 0, 203.1341855918611, 40.415188025756855},
    // {4, 4, 208.86542961099985, 56.45473683027467},
    // {8, 2, 218.04054922822473, 57.21523267876469},
    // {8, 4, 226.27633870190894, 73.60046141441433},
    // {8, 6, 231.70826177883202, 88.4646984530838},
    // {8, 8, 240.63270622327644, 102.4301676708105},
};
```

## src/ble_hci_vsc.c
```c
#include <zephyr/sys/byteorder.h>
#include <zephyr/drivers/gpio.h>
#include "ble_hci_vsc.h"
#include "bluetooth/hci.h"

static struct ble_hci_vs_tx_pwr_setting available_vs_tx_pwr_settings[14];

enum ble_hci_vs_max_tx_power {
	BLE_HCI_VSC_MAX_TX_PWR_0dBm = 0,
	BLE_HCI_VSC_MAX_TX_PWR_3dBm = 3,
};

void init_ble_hci_vsc_tx_pwr()
{
	available_vs_tx_pwr_settings[0].tx_power = BLE_HCI_VSC_TX_PWR_Neg40dBm;
	available_vs_tx_pwr_settings[0].add_3dBm = false;
	available_vs_tx_pwr_settings[1].tx_power = BLE_HCI_VSC_TX_PWR_Neg20dBm;
	available_vs_tx_pwr_settings[1].add_3dBm = false;
	available_vs_tx_pwr_settings[2].tx_power = BLE_HCI_VSC_TX_PWR_Neg16dBm;
	available_vs_tx_pwr_settings[2].add_3dBm = false;
	available_vs_tx_pwr_settings[3].tx_power = BLE_HCI_VSC_TX_PWR_Neg12dBm;
	available_vs_tx_pwr_settings[3].add_3dBm = false;
	available_vs_tx_pwr_settings[4].tx_power = BLE_HCI_VSC_TX_PWR_Neg8dBm;
	available_vs_tx_pwr_settings[4].add_3dBm = false;
	available_vs_tx_pwr_settings[5].tx_power = BLE_HCI_VSC_TX_PWR_Neg7dBm;
	available_vs_tx_pwr_settings[5].add_3dBm = false;
	available_vs_tx_pwr_settings[6].tx_power = BLE_HCI_VSC_TX_PWR_Neg6dBm;
	available_vs_tx_pwr_settings[6].add_3dBm = false;
	available_vs_tx_pwr_settings[7].tx_power = BLE_HCI_VSC_TX_PWR_Neg5dBm;
	available_vs_tx_pwr_settings[7].add_3dBm = false;
	available_vs_tx_pwr_settings[8].tx_power = BLE_HCI_VSC_TX_PWR_Neg4dBm;
	available_vs_tx_pwr_settings[8].add_3dBm = false;
	available_vs_tx_pwr_settings[9].tx_power = BLE_HCI_VSC_TX_PWR_Neg3dBm;
	available_vs_tx_pwr_settings[9].add_3dBm = false;
	available_vs_tx_pwr_settings[10].tx_power = BLE_HCI_VSC_TX_PWR_Neg2dBm;
	available_vs_tx_pwr_settings[10].add_3dBm = false;
	available_vs_tx_pwr_settings[11].tx_power = BLE_HCI_VSC_TX_PWR_Neg1dBm;
	available_vs_tx_pwr_settings[11].add_3dBm = false;
	available_vs_tx_pwr_settings[12].tx_power = BLE_HCI_VSC_TX_PWR_0dBm;
	available_vs_tx_pwr_settings[12].add_3dBm = false;
	available_vs_tx_pwr_settings[13].tx_power = BLE_HCI_VSC_TX_PWR_0dBm;
	available_vs_tx_pwr_settings[13].add_3dBm = true;
}

uint8_t get_hci_vsc_tx_pwr_idx(int8_t txp)
{
	switch (txp)
	{
	case -30:
		return 0;
		break;
	case -20:
		return 1;
		break;
	case -16:
		return 2;
		break;
	case -12:
		return 3;
		break;
	case -8:
		return 4;
		break;
	case -7:
		return 5;
		break;
	case -6:
		return 6;
		break;
	case -5:
		return 7;
		break;
	case -4:
		return 8;
		break;
	case -3:
		return 9;
		break;
	case -2:
		return 10;
		break;
	case -1:
		return 11;
		break;
	case 0:
		return 13;
		break;
	default:
		return 99;
		break;
	}
}

uint8_t get_txp_value_by_index(uint8_t txp_idx)
{
	return available_vs_tx_pwr_settings[txp_idx].tx_power;
}

int ble_hci_vsc_set_radio_high_pwr_mode(bool high_power_mode)
{
	int ret;
	struct ble_hci_vs_cp_set_radio_fe_cfg *cp;
	struct ble_hci_vs_rp_status *rp;
	struct net_buf *buf, *rsp = NULL;

	buf = bt_hci_cmd_create(HCI_OPCODE_VS_SET_RADIO_FE_CFG, sizeof(*cp));
	if (!buf) {
		printk("Unable to allocate command buffer\n");
		return -ENOMEM;
	}
	cp = net_buf_add(buf, sizeof(*cp));
	if (high_power_mode) {
		// printk("Enable VREGRADIO.VREQH\n");
		cp->max_tx_power = BLE_HCI_VSC_MAX_TX_PWR_3dBm;
	} else {
		// printk("Disable VREGRADIO.VREQH\n");
		cp->max_tx_power = BLE_HCI_VSC_MAX_TX_PWR_0dBm;
	}
	cp->ant_id = 0;

	ret = bt_hci_cmd_send_sync(HCI_OPCODE_VS_SET_RADIO_FE_CFG, buf, &rsp);
	if (ret) {
		printk("Error for HCI VS command HCI_OPCODE_VS_SET_RADIO_FE_CFG\n");
		return ret;
	}

	rp = (void *)rsp->data;
	ret = rp->status;
	net_buf_unref(rsp);
	return ret;
}

int ble_hci_vsc_set_adv_tx_pwr(enum ble_hci_vs_tx_power tx_power)
{
	int ret;
	struct ble_hci_vs_cp_set_adv_tx_pwr *cp;
	struct ble_hci_vs_rp_status *rp;
	struct net_buf *buf, *rsp = NULL;

	buf = bt_hci_cmd_create(HCI_OPCODE_VS_SET_ADV_TX_PWR, sizeof(*cp));
	if (!buf) {
		printk("Unable to allocate command buffer\n");
		return -ENOMEM;
	}
	cp = net_buf_add(buf, sizeof(*cp));
	cp->tx_power = tx_power;

	ret = bt_hci_cmd_send_sync(HCI_OPCODE_VS_SET_ADV_TX_PWR, buf, &rsp);
	if (ret) {
		printk("Error for HCI VS command HCI_OPCODE_VS_SET_ADV_TX_PWR\n");
		return ret;
	}

	rp = (void *)rsp->data;
	ret = rp->status;
	net_buf_unref(rsp);

	return ret;
}

int ble_hci_vsc_set_pri_ext_adv_max_tx_pwr(enum ble_hci_vs_tx_power tx_power)
{
	int ret;
	struct ble_hci_vs_cp_set_adv_tx_pwr *cp;
	struct ble_hci_vs_rp_status *rp;
	struct net_buf *buf, *rsp = NULL;

	buf = bt_hci_cmd_create(HCI_OPCODE_VS_SET_PRI_EXT_ADV_MAX_TX_PWR, sizeof(*cp));
	if (!buf) {
		printk("Unable to allocate command buffer\n");
		return -ENOMEM;
	}
	cp = net_buf_add(buf, sizeof(*cp));
	cp->tx_power = tx_power;

	ret = bt_hci_cmd_send_sync(HCI_OPCODE_VS_SET_PRI_EXT_ADV_MAX_TX_PWR, buf, &rsp);
	if (ret) {
		printk("Error for HCI VS command HCI_OPCODE_VS_SET_PRI_EXT_ADV_MAX_TX_PWR\n");
		return ret;
	}

	rp = (void *)rsp->data;
	ret = rp->status;
	net_buf_unref(rsp);
	return ret;
}

int ble_hci_vsc_set_tx_pwr(uint8_t pwr_setting_index)
{
	int ret;

	struct ble_hci_vs_tx_pwr_setting setting = available_vs_tx_pwr_settings[pwr_setting_index];

	ret = ble_hci_vsc_set_radio_high_pwr_mode(setting.add_3dBm);
	if (ret) {
		printk("Error for HCI VS command ble_hci_vsc_set_radio_high_pwr_mode\n");
		return ret;
	}

	ret = ble_hci_vsc_set_adv_tx_pwr(setting.tx_power);
	if (ret) {
		printk("Error for HCI VS command ble_hci_vsc_set_adv_tx_pwr\n");
		return ret;
	}

	ret = ble_hci_vsc_set_pri_ext_adv_max_tx_pwr(setting.tx_power);
	if (ret) {
		printk("Error for HCI VS command ble_hci_vsc_set_pri_ext_adv_max_tx_pwr\n");
		return ret;
	}

	return ret;
}

int ble_hci_vsc_set_conn_tx_pwr(uint16_t conn_handle, enum ble_hci_vs_tx_power tx_power)
{
	int ret;
	struct ble_hci_vs_cp_set_conn_tx_pwr *cp;
	struct ble_hci_vs_rp_status *rp;
	struct net_buf *buf, *rsp = NULL;

	buf = bt_hci_cmd_create(HCI_OPCODE_VS_SET_CONN_TX_PWR, sizeof(*cp));
	if (!buf) {
		printk("Unable to allocate command buffer\n");
		return -ENOMEM;
	}
	cp = net_buf_add(buf, sizeof(*cp));
	cp->handle = conn_handle;
	cp->tx_power = tx_power;

	ret = bt_hci_cmd_send_sync(HCI_OPCODE_VS_SET_CONN_TX_PWR, buf, &rsp);
	if (ret) {
		printk("Error for HCI VS command HCI_OPCODE_VS_SET_CONN_TX_PWR\n");
		return ret;
	}

	rp = (void *)rsp->data;
	ret = rp->status;
	net_buf_unref(rsp);

	return ret;
}

int ble_hci_vsc_set_conn_tx_pwr_index(uint16_t conn_handle, uint8_t pwr_setting_index)
{
	int ret;

	struct ble_hci_vs_tx_pwr_setting setting = available_vs_tx_pwr_settings[pwr_setting_index];

	ret = ble_hci_vsc_set_radio_high_pwr_mode(setting.add_3dBm);
	if (ret) {
		printk("Error for HCI VS command ble_hci_vsc_set_radio_high_pwr_mode\n");
		return ret;
	}

	ret = ble_hci_vsc_set_conn_tx_pwr(conn_handle, setting.tx_power);
	if (ret) {
		printk("Error for HCI VS command ble_hci_vsc_set_conn_tx_pwr\n");
		return ret;
	}

	return ret;
}
```
